/* Firmware entry: 0x4809bd96 */

void FUN_ram_4809bd96(undefined4 *param_1)

{
  undefined4 *puVar1;
  char *pcVar2;
  undefined4 *puVar3;
  char cVar4;
  undefined1 *puVar5;
  undefined4 *puVar6;
  undefined4 *puVar7;
  undefined4 *puVar8;
  undefined1 *puVar9;
  
  gp = &PTR_s_Print_task_snapshots_ram_481c0790_ram_4ff48580;
  param_1[1] = 0;
  param_1[2] = 0;
  param_1[3] = 0;
  *(undefined1 *)(param_1 + 4) = 7;
  *param_1 = &PTR_LAB_ram_4809b712_ram_481f5324;
  puVar3 = param_1 + 0xd4f;
  puVar8 = param_1 + 0xb5d;
  puVar9 = (undefined1 *)((int)param_1 + 0x87a);
  puVar1 = param_1 + 0x129;
  do {
    memset(puVar1 + -0x123,0,0x3578);
    memset(puVar1 + -0xb5,0,0x2d0);
    puVar6 = puVar1 + -0xab;
    *(undefined1 *)(puVar1 + -0xb4) = 8;
    *(undefined1 *)((int)puVar1 + -0x2ba) = 1;
    do {
      *(undefined1 *)puVar6 = 8;
      *(undefined1 *)((int)puVar6 + 0x16) = 1;
      puVar6 = puVar6 + 9;
    } while (puVar6 != puVar1);
    *(undefined1 *)(puVar1 + -1) = 0;
    memset(puVar1,0,0x7c);
    *puVar1 = 0;
    *(undefined1 *)(puVar1 + 1) = 8;
    *(undefined1 *)((int)puVar1 + 5) = 0;
    *(undefined1 *)((int)puVar1 + 6) = 0;
    *(undefined1 *)((int)puVar1 + 7) = 0;
    *(undefined1 *)(puVar1 + 2) = 0;
    *(undefined1 *)((int)puVar1 + 9) = 0;
    *(undefined1 *)((int)puVar1 + 10) = 0;
    *(undefined1 *)((int)puVar1 + 0xb) = 0;
    *(undefined1 *)(puVar1 + 3) = 0;
    *(undefined1 *)((int)puVar1 + 0xd) = 0;
    *(undefined2 *)((int)puVar1 + 0xe) = 0;
    puVar1[4] = 0;
    puVar1[5] = 0;
    *(undefined1 *)(puVar1 + 6) = 0;
    *(byte *)((int)puVar1 + 0x19) = *(byte *)((int)puVar1 + 0x19) & 0xfc;
    *(undefined2 *)((int)puVar1 + 0x1a) = 1;
    puVar1[7] = 0;
    puVar1[8] = 0;
    puVar1[0xd] = 0;
    *(undefined1 *)(puVar1 + 0xe) = 8;
    *(undefined1 *)((int)puVar1 + 0x39) = 0;
    *(undefined1 *)((int)puVar1 + 0x3a) = 0;
    *(undefined1 *)((int)puVar1 + 0x3b) = 0;
    *(undefined1 *)(puVar1 + 0xf) = 0;
    *(undefined1 *)((int)puVar1 + 0x3d) = 0;
    *(undefined1 *)((int)puVar1 + 0x3e) = 0;
    *(undefined1 *)((int)puVar1 + 0x3f) = 0;
    *(undefined1 *)(puVar1 + 0x10) = 0;
    *(undefined1 *)((int)puVar1 + 0x41) = 0;
    *(undefined2 *)((int)puVar1 + 0x42) = 0;
    puVar1[0x11] = 0;
    puVar1[0x12] = 0;
    *(undefined1 *)(puVar1 + 0x13) = 0;
    *(byte *)((int)puVar1 + 0x4d) = *(byte *)((int)puVar1 + 0x4d) & 0xfc;
    *(undefined2 *)((int)puVar1 + 0x4e) = 1;
    puVar1[0x14] = 0;
    puVar1[0x15] = 0;
    memset(puVar1 + 0x4b,0,0x288);
    puVar5 = (undefined1 *)((int)puVar1 + 0x172);
    *(undefined1 *)((int)puVar1 + 0x14e) = 1;
    do {
      *puVar5 = 1;
      puVar5 = puVar5 + 0x24;
    } while (puVar5 != puVar9);
    puVar1[0xf0] = 0;
    *(undefined1 *)(puVar1 + 0xf1) = 8;
    *(undefined1 *)((int)puVar1 + 0x3c5) = 0;
    *(undefined1 *)((int)puVar1 + 0x3c6) = 0;
    *(undefined1 *)((int)puVar1 + 0x3c7) = 0;
    *(undefined1 *)(puVar1 + 0xf2) = 0;
    *(undefined1 *)((int)puVar1 + 0x3c9) = 0;
    *(undefined1 *)((int)puVar1 + 0x3ca) = 0;
    *(undefined1 *)((int)puVar1 + 0x3cb) = 0;
    *(undefined1 *)(puVar1 + 0xf3) = 0;
    *(undefined1 *)((int)puVar1 + 0x3cd) = 0;
    *(undefined2 *)((int)puVar1 + 0x3ce) = 0;
    puVar1[0xf4] = 0;
    puVar1[0xf5] = 0;
    *(undefined1 *)(puVar1 + 0xf6) = 0;
    *(byte *)((int)puVar1 + 0x3d9) = *(byte *)((int)puVar1 + 0x3d9) & 0xfc;
    *(undefined2 *)((int)puVar1 + 0x3da) = 1;
    puVar1[0xf7] = 0;
    puVar1[0xf8] = 0;
    *(undefined1 *)(puVar1 + 0xfe) = 1;
    puVar1[0x105] = 0;
    puVar1[0x10e] = 0xffffffff;
    puVar1[0xfa] = 0xb33fffff;
    puVar8[-0x60] = 0;
    puVar8[-0x5f] = 0;
    puVar8[-0x5e] = 0;
    puVar8[-0x5d] = 0;
    puVar8[-0x5c] = 0;
    puVar8[-0x5b] = 0;
    puVar8[-0x5a] = 0;
    puVar8[-0x59] = 0xffffffff;
    puVar8[-0x58] = 0xffffffff;
    puVar6 = puVar1 + 0x9e0;
    puVar8[-0x57] = 0xffffffff;
    puVar8[-0x56] = 0xff00;
    *(undefined2 *)(puVar8 + -0x55) = 0;
    *(undefined1 *)((int)puVar8 + -0x152) = 0;
    do {
      *puVar6 = 0;
      puVar6[1] = 0;
      puVar6[2] = 0;
      puVar6[3] = 0;
      puVar6[4] = 0;
      puVar6[5] = 0;
      puVar6[6] = 0;
      puVar6[7] = 0xffffffff;
      puVar6[8] = 0xffffffff;
      puVar6[9] = 0xffffffff;
      puVar6[10] = 0xff00;
      *(undefined2 *)(puVar6 + 0xb) = 0;
      *(undefined1 *)((int)puVar6 + 0x2e) = 0;
      puVar6 = puVar6 + 0xc;
    } while (puVar6 != puVar8);
    puVar8[0x47] = 1;
    puVar8[0x48] = 1;
    puVar8[0x49] = 0;
    *(undefined1 *)(puVar8 + 0x4a) = 8;
    *(undefined1 *)((int)puVar1 + 0x29f9) = 0;
    *(undefined1 *)((int)puVar1 + 0x29fa) = 0;
    *(undefined1 *)((int)puVar1 + 0x29fb) = 0;
    *(undefined1 *)(puVar1 + 0xa7f) = 0;
    *(undefined1 *)((int)puVar1 + 0x29fd) = 0;
    *(undefined1 *)((int)puVar1 + 0x29fe) = 0;
    *(undefined1 *)((int)puVar1 + 0x29ff) = 0;
    *(undefined1 *)(puVar1 + 0xa80) = 0;
    *(undefined1 *)((int)puVar8 + 0x131) = 0;
    *(undefined2 *)((int)puVar8 + 0x132) = 0;
    puVar8[0x4d] = 0;
    puVar8[0x4e] = 0;
    *(undefined1 *)(puVar8 + 0x4f) = 0;
    *(byte *)((int)puVar1 + 0x2a0d) = *(byte *)((int)puVar1 + 0x2a0d) & 0xfc;
    *(undefined2 *)((int)puVar8 + 0x13e) = 1;
    puVar8[0x50] = 0;
    puVar8[0x51] = 0;
    puVar8[199] = 0xffffffff;
    *(undefined1 *)((int)puVar8 + 0x331) = 1;
    memset(puVar1 + 0xb7f,0,0x260);
    puVar8[0x15a] = 0xffffffff;
    puVar8[0x15b] = 0xffffffff;
    *(undefined1 *)(puVar8 + 0x15c) = 0xff;
    puVar6 = puVar1 + 0xba1;
    do {
      puVar7 = puVar6;
      *puVar7 = 0xffffffff;
      puVar7[1] = 0xffffffff;
      *(undefined1 *)(puVar7 + 2) = 0xff;
      puVar6 = puVar7 + 0x13;
    } while (puVar7 + 0x13 != puVar3);
    memset(puVar1 + 0xc17,0,0x80);
    *(undefined1 *)((int)puVar7 + 0x1e) = 1;
    *(undefined1 *)((int)puVar7 + 0x2e) = 1;
    *(undefined1 *)((int)puVar7 + 0x3e) = 1;
    *(undefined1 *)((int)puVar7 + 0x4e) = 1;
    *(undefined1 *)((int)puVar7 + 0x5e) = 1;
    *(undefined1 *)((int)puVar7 + 0x6e) = 1;
    *(undefined1 *)((int)puVar7 + 0x7e) = 1;
    *(undefined1 *)((int)puVar7 + 0x8e) = 1;
    *(undefined1 *)((int)puVar7 + 0x9e) = 1;
    puVar1 = puVar1 + 0xd5e;
    puVar3 = puVar7 + 0xd71;
    puVar8 = puVar8 + 0xd5e;
    puVar9 = puVar9 + 0x3578;
  } while (puVar1 != param_1 + 0x2943);
  memset(param_1 + 0x2820,0,400);
  *(undefined1 *)((int)param_1 + 0xa0c2) = 1;
  param_1[0x2838] = 0xffffffff;
  *(undefined1 *)(param_1 + 0x284c) = 0xff;
  *(undefined1 *)((int)param_1 + 0xa18a) = 1;
  param_1[0x286a] = 0xffffffff;
  *(undefined1 *)(param_1 + 0x287e) = 0xff;
  *(undefined1 *)(param_1 + 0x282b) = 8;
  *(undefined1 *)(param_1 + 0x285d) = 8;
  memset(param_1 + 0x2884,0,400);
  *(undefined1 *)(param_1 + 0x288f) = 8;
  *(undefined1 *)((int)param_1 + 0xa252) = 1;
  param_1[0x289c] = 0xffffffff;
  *(undefined1 *)(param_1 + 0x28b0) = 0xff;
  *(undefined1 *)(param_1 + 0x28c1) = 8;
  *(undefined1 *)((int)param_1 + 0xa31a) = 1;
  param_1[0x28ce] = 0xffffffff;
  *(undefined1 *)(param_1 + 0x28e2) = 0xff;
  memset(param_1 + 0x28e8,0,200);
  *(undefined1 *)(param_1 + 0x28f3) = 8;
  *(undefined1 *)((int)param_1 + 0xa3e2) = 1;
  param_1[0x2900] = 0xffffffff;
  *(undefined1 *)(param_1 + 0x2914) = 0xff;
  memset(param_1 + 0x291c,0,0x1400);
  memset(param_1 + 0x2e1c,0,0x240);
  memset(param_1 + 0x2eac,0,0x90);
  memset(param_1 + 0x2ed0,0,0x900);
  *(undefined1 *)(param_1 + 0x2ed1) = 8;
  *(undefined1 *)((int)param_1 + 0xbb5a) = 1;
  puVar1 = param_1 + 0x2eda;
  do {
    *(undefined1 *)puVar1 = 8;
    *(undefined1 *)((int)puVar1 + 0x16) = 1;
    puVar1 = puVar1 + 9;
  } while (puVar1 != param_1 + 0x3111);
  memset(param_1 + 0x3110,0,0x40);
  *(undefined2 *)(param_1 + 0x3124) = 0;
  *(undefined1 *)((int)param_1 + 0xc492) = 0;
  memset(param_1 + 0x3120,0xff,0x10);
  pcVar2 = (char *)(param_1 + 0x3110);
  cVar4 = '\0';
  do {
    cVar4 = cVar4 + '\x01';
    *pcVar2 = cVar4;
    pcVar2 = pcVar2 + 1;
  } while (cVar4 != '?');
  *(undefined1 *)((int)param_1 + 0xc47f) = 0xff;
  *(undefined1 *)((int)param_1 + 0xc492) = 0;
  memset(param_1 + 0x3125,0,0x120);
  *(undefined1 *)(param_1 + 0x3126) = 8;
  *(undefined1 *)((int)param_1 + 0xc4ae) = 1;
  puVar1 = param_1 + 0x312f;
  do {
    *(undefined1 *)puVar1 = 8;
    *(undefined1 *)((int)puVar1 + 0x16) = 1;
    puVar1 = puVar1 + 9;
  } while (param_1 + 0x316e != puVar1);
  *(undefined2 *)(param_1 + 0x3173) = 0;
  *(undefined1 *)((int)param_1 + 0xc5ce) = 0;
  memset(param_1 + 0x316f,0xff,0x10);
  param_1[0x316d] = 0x4030201;
  param_1[0x316e] = 0xff070605;
  *(undefined1 *)((int)param_1 + 0xc5ce) = 0;
  param_1[0x3174] = 0;
  param_1[0x3175] = 0;
  param_1[0x3176] = 0;
  param_1[0x3177] = 0;
  memset(param_1 + 0x3178,0,0x600);
  *(undefined1 *)(param_1 + 0x3179) = 8;
  *(undefined1 *)((int)param_1 + 0xc5fa) = 1;
  puVar1 = param_1 + 0x3185;
  do {
    *(undefined1 *)puVar1 = 8;
    *(undefined1 *)((int)puVar1 + 0x16) = 1;
    puVar1 = puVar1 + 0xc;
  } while (param_1 + 0x32f9 != puVar1);
  *(undefined2 *)(param_1 + 0x32f8) = 0;
  *(undefined1 *)((int)param_1 + 0xcbe2) = 0;
  memset(param_1 + 0x32fc,0,0x1400);
  memset(param_1 + 0x37fc,0,0xf00);
  memset(param_1 + 0x3bbc,0,0x480);
  memset(param_1 + 0x3cdc,0,0x480);
  memset(param_1 + 0x3dfc,0,0x480);
  memset(param_1 + 0x3f1c,0,0x480);
  memset(param_1 + 0x403c,0,0x480);
  memset(param_1 + 0x415c,0,0x480);
  memset(param_1 + 0x427c,0,0x780);
  memset(param_1 + 0x445c,0,0x780);
  memset(param_1 + 0x463c,0,0x780);
  param_1[0x481d] = 0xb33fffff;
  *(undefined1 *)(param_1 + 0x481c) = 0;
  param_1[0x481e] = 0;
  memset(param_1 + 0x481f,0,0x5c);
  memset(param_1 + 0x4838,0,0x2c00);
  memset(param_1 + 0x5338,0,0x5c);
  memset(param_1 + 0x5350,0,0x2c0);
  memset(param_1 + 0x5400,0,0x5c);
  memset(param_1 + 0x5418,0,0x2100);
  param_1[0x5c58] = 0;
  memset(param_1 + 0x5c59,0,0x5c);
  memset(param_1 + 0x5c70,0,0xd00);
  param_1[0x5fb0] = 0;
  param_1[0x5fb1] = 0;
  *(undefined1 *)(param_1 + 0x5fb2) = 0;
  memset(param_1 + 0x5fb3,0,0x6cc);
  puVar3 = param_1 + 0x6044;
  puVar1 = param_1 + 0x61f7;
  do {
    *(undefined1 *)(puVar3 + -0x90) = 8;
    *(undefined1 *)((int)puVar3 + -0x22a) = 1;
    puVar8 = puVar3 + -0x87;
    do {
      puVar6 = puVar8;
      *(undefined1 *)puVar6 = 8;
      *(undefined1 *)((int)puVar6 + 0x16) = 1;
      puVar8 = puVar6 + 9;
    } while (puVar6 + 9 != puVar3);
    puVar3 = puVar6 + 0x9a;
  } while (puVar1 != puVar3);
  memset(param_1 + 0x6166,0,0x6cc);
  do {
    *(undefined1 *)(puVar1 + -0x90) = 8;
    *(undefined1 *)((int)puVar1 + -0x22a) = 1;
    puVar3 = puVar1 + -0x87;
    do {
      puVar8 = puVar3;
      *(undefined1 *)puVar8 = 8;
      *(undefined1 *)((int)puVar8 + 0x16) = 1;
      puVar3 = puVar8 + 9;
    } while (puVar8 + 9 != puVar1);
    puVar1 = puVar8 + 0x9a;
  } while (param_1 + 0x63aa != puVar1);
  param_1[0x6319] = 0;
  *(undefined2 *)(param_1 + 0x631b) = 0;
  *(undefined1 *)((int)param_1 + 0x18c6e) = 0;
  param_1[0x631c] = 1;
  param_1[0x631d] = 0;
  *(undefined1 *)(param_1 + 0x631e) = 0;
  param_1[0x631a] = 0x1010100;
  memset(param_1 + 0x631f,0,0x104);
  param_1[0x6360] = 0;
  param_1[0x6361] = 0;
  *(undefined2 *)(param_1 + 0x6362) = 0;
  param_1[0x6363] = 0;
  *(undefined1 *)(param_1 + 0x6364) = 0;
  return;
}


